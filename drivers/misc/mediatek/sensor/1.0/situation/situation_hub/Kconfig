## drivers/misc/mediatek/sensor/1.0/situation/situation_hub/Kconfig
```kconfig
source "$(KCONFIG_EXT_PREFIX)drivers/misc/mediatek/sensor/1.0/situation/situation_hub/stationary/Kconfig"
source "$(KCONFIG_EXT_PREFIX)drivers/misc/mediatek/sensor/1.0/situation/situation_hub/inpocket/Kconfig"
source "$(KCONFIG_EXT_PREFIX)drivers/misc/mediatek/sensor/1.0/situation/situation_hub/wake_gesture/Kconfig"
source "$(KCONFIG_EXT_PREFIX)drivers/misc/mediatek/sensor/1.0/situation/situation_hub/glance_gesture/Kconfig"
source "$(KCONFIG_EXT_PREFIX)drivers/misc/mediatek/sensor/1.0/situation/situation_hub/answercall/Kconfig"
source "$(KCONFIG_EXT_PREFIX)drivers/misc/mediatek/sensor/1.0/situation/situation_hub/pickup_gesture/Kconfig"
source "$(KCONFIG_EXT_PREFIX)drivers/misc/mediatek/sensor/1.0/situation/situation_hub/device_orientation/Kconfig"
source "$(KCONFIG_EXT_PREFIX)drivers/misc/mediatek/sensor/1.0/situation/situation_hub/motion_detect/Kconfig"
source "$(KCONFIG_EXT_PREFIX)drivers/misc/mediatek/sensor/1.0/situation/situation_hub/tilt_detector/Kconfig"
source "$(KCONFIG_EXT_PREFIX)drivers/misc/mediatek/sensor/1.0/situation/situation_hub/flat/Kconfig"
source "$(KCONFIG_EXT_PREFIX)drivers/misc/mediatek/sensor/1.0/situation/situation_hub/sar/Kconfig"
source "$(KCONFIG_EXT_PREFIX)drivers/misc/mediatek/sensor/1.0/situation/situation_hub/rear_als/Kconfig"
source "$(KCONFIG_EXT_PREFIX)drivers/misc/mediatek/sensor/1.0/situation/situation_hub/rear_flk/Kconfig"

#TN Begin modified by jiawei.zou 20220825 EKLAMU-207 start
source "$(KCONFIG_EXT_PREFIX)drivers/misc/mediatek/sensor/1.0/situation/situation_hub/flip_twist/Kconfig"
source "$(KCONFIG_EXT_PREFIX)drivers/misc/mediatek/sensor/1.0/situation/situation_hub/chop_chop/Kconfig"
source "$(KCONFIG_EXT_PREFIX)drivers/misc/mediatek/sensor/1.0/situation/situation_hub/sig_move/Kconfig"
source "$(KCONFIG_EXT_PREFIX)drivers/misc/mediatek/sensor/1.0/situation/situation_hub/flip/Kconfig"
source "$(KCONFIG_EXT_PREFIX)drivers/misc/mediatek/sensor/1.0/situation/situation_hub/tap_tap/Kconfig"
#TN Begin modified by jiawei.zou 20220825 EKLAMU-207 end

config MTK_REAR_ALS_HUB
	bool "rearalshub for MediaTek package"
	help
	  A sar is a device,
	  usually portable and electronic
	  or electromechanical,
	  that detect distance between the body and device .
```

## drivers/misc/mediatek/sensor/1.0/situation/situation_hub/flip/Kconfig
```kconfig
config MTK_FLIP_HUB
	bool "FLIP for MediaTek package"
	help
	  FLIP is a device,
	  usually portable and electronic
	  or electromechanical,
	  that detect device is flipped.
```

## drivers/misc/mediatek/sensor/1.0/situation/situation_hub/rear_als/Kconfig
```kconfig
config MTK_REAR_ALS_HUB
	bool "rearalshub for MediaTek package"
	help
	  A als is a device,
	  usually portable and electronic
	  or electromechanical,
	  that detect distance between the body and device .
```

## drivers/misc/mediatek/sensor/1.0/situation/situation_hub/rear_flk/Kconfig
```kconfig
config MTK_REAR_FLK_HUB
	bool "rearflkhub for MediaTek package"
	help
	  A flk is a device,
	  usually portable and electronic
	  or electromechanical,
	  that detect distance between the body and device .
```

## drivers/misc/mediatek/sensor/1.0/situation/situation_hub/tap_tap/Kconfig
```kconfig
config MTK_TAP_TAP_HUB
	bool "TAP_TAP for MediaTek package"
	help
	  TAP_TAP is a device,
	  usually portable and electronic
	  or electromechanical,
	  that detect device back is taped twice.
```

## oem/Kconfig
```kconfig
config OEM_PROJECT
	 bool "Enable oem project config"
	default n
	help
	  enable oem project config.

config PROJECT_LAMU
	bool "oem project lamu"
	default n
	help
	  config oem project name.

config PROJECT_P325A
       bool "oem project p325a"
       default n
       help
          config oem project name.

config FACTORY_BUILD
       bool "oem factory build"
       default n
       help
          config oem factory build.

config OEM_DEVINFO
       tristate "oem_devinfo"
       depends on OEM_PROJECT
       default m
       help
          support oem_devinfo

config OEM_TOUCHSCREEN
	tristate "oem touch"
	depends on PROJECT_P325A
	default m
	help
	  support oem_touch

config OEM_PANEL
	tristate "oem panel"
	depends on PROJECT_P325A
	default m
	help
	  support oem_panel

config OEM_LAMU_TOUCHSCREEN
	tristate "oem touch"
	depends on PROJECT_LAMU
	default m
	help
	  support oem_touch

config OEM_LAMU_PANEL
	tristate "oem panel"
	depends on PROJECT_LAMU
	default m
	help
	  support oem_panel

config OEM_LAMU_FINGERPRINT
	tristate "oem fingerprint"
	depends on PROJECT_LAMU
	default m
	help
	  support oem_touch

config SND_SOC_FS1815
	tristate "oem aduiopa"
	depends on PROJECT_LAMU
	default n
	help
	  support oem aduiopa

config NXP_NFC_I2C
    tristate "oem nxp pn560uk"
    depends on PROJECT_LAMU
    default m
    help
      support oem_nxp_pn560uk

config SND_SOC_AW87XXX
        tristate "SoC Audio for awinic AW87XXX analog PA"
        depends on PROJECT_LAMU
        default m
        help
          support aw87xxx analog aw_audiopa

source "$(KCONFIG_EXT_PREFIX)/oem/sensors/Kconfig"

config OEM_DRE_MODE
	tristate "dre mode"
	depends on PROJECT_LAMU
	default n
	help
	  support dre_mode
```

## oem/sensors/Kconfig
```kconfig
config AWINIC_SAR
        tristate "AW Sar sensor"
        depends on OEM_PROJECT
        default n
        help
          support AW Sar sensor

config HX9031_SAR
        tristate "HX9031 Sar sensor"
        depends on OEM_PROJECT
        default n
        help
          support HX Sar sensor

config OEM_ANT_DET
	    tristate "oem antdet"
	    depends on OEM_PROJECT
	    default n
	    help
	      support oem_antdet
```

## oem/tinno_charger/Kconfig
```kconfig
config NO_THERMAL_BUILD
	bool "oem project no thermal build"
	default n
	help
	  config oem project no thermal build.

config OEM_TINNO_CHARGER
	tristate "oem tinno charger"
	default n
	help
	  support oem_tinno_charger

config OEM_SWITCH_CHARGER
	tristate "oem third party switch charger support"
	default n
	help
	  support oem_switch_charger

config OEM_CHARGER_PUMP
	tristate "oem third party charger pump support"
	default n
	help
	  support oem_charger_pump

config OEM_TCPC
	tristate "oem third party cc logic support"
	default n
	help
	  support oem_tcpc

config OEM_QC_LOGIC
	tristate "oem third party qc logic support"
	default n
	help
	  support oem_qc_logic

config OEM_FUEL_GAUGE
	tristate "oem third party fuel gauge support"
	default n
	help
	  support oem_fuel_gauge

config OEM_BATTERY_SWITCH
	tristate "oem third party battery switch support"
	default n
	help
	  support oem_battery_switch

config OEM_SWITCH_CHARGER_SC89890H
	tristate "oem switch charger sc89890h"
	depends on OEM_SWITCH_CHARGER
	default n
	help
	  support oem_switch_charger_sc89890h

config OEM_SWITCH_CHARGER_SGM41542
	tristate "oem switch charger sgm41542"
	depends on OEM_SWITCH_CHARGER
	default n
	help
	  support oem_switch_charger_sgm41542

config OEM_SWITCH_CHARGER_CX2589X
	tristate "oem switch charger cx2589x"
	depends on OEM_SWITCH_CHARGER
	default n
	help
	  support oem_switch_charger_cx2589x

config OEM_SWITCH_CHARGER_CX25601D
	tristate "oem switch charger cx25601d"
	depends on OEM_SWITCH_CHARGER
	default n
	help
	  support oem_switch_charger_cx25601d

config OEM_SWITCH_CHARGER_ETA6937
	tristate "oem switch charger eta6937"
	depends on OEM_SWITCH_CHARGER
	default n
	help
	  support oem_switch_charger_eta6937

config OEM_CHARGER_PUMP_SC8541
	tristate "oem charger pump sc8541"
	depends on OEM_CHARGER_PUMP
	default n
	help
	  support oem_charger_pump_sc8541

config OEM_CHARGER_PUMP_NU2115
	tristate "oem charger pump nu2115"
	depends on OEM_CHARGER_PUMP
	default n
	help
	  support oem_charger_pump_nu2115

config OEM_CHARGER_PUMP_CPS2011S
	tristate "oem charger pump cps2011s"
	depends on OEM_CHARGER_PUMP
	default n
	help
	  support oem_charger_pump_cps2011s

config OEM_CHARGER_PUMP_SGM41600S
	tristate "oem charger pump sgm41600s"
	depends on OEM_CHARGER_PUMP
	default n
	help
	  support oem_charger_pump_41600s

config OEM_TCPC_AW35616
	tristate "oem tcpc aw35616"
	depends on OEM_TCPC
	default n
	help
	  support oem_tcpc_aw35616

config OEM_TCPC_HUSB320
	tristate "oem tcpc husb320"
	depends on OEM_TCPC
	default n
	help
	  support oem_tcpc_husb320

config OEM_TCPC_SGM7220
	tristate "oem tcpc sgm7220"
	depends on OEM_TCPC
	default n
	help
	  support oem_tcpc_sgm7220

config OEM_TCPC_PD_SC2150
	tristate "oem tcpc pd sc2150"
	depends on OEM_TCPC
	default n
	help
	  support oem_tcpc_pd_sc2150

config OEM_TCPC_PD_CPS8851
	tristate "oem tcpc pd cps8851"
	depends on OEM_TCPC
	default n
	help
	  support oem_tcpc_pd_cps8851

config OEM_TCPC_PD_AW35615
	tristate "oem tcpc pd aw35615"
	depends on OEM_TCPC
	default n
	help
	  support oem_tcpc_pd_aw35615

config OEM_TURBO_CHARGER
	tristate "oem turbo charger"
	default n
	help
	  support oem_turbo_charger

config OEM_QC_LOGIC_Z350
	tristate "oem qc logic z350"
	depends on OEM_QC_LOGIC
	default n
	help
	  support oem_qc_logic_z350

config OEM_QC_LOGIC_WT6670F
	tristate "oem qc logic wt6670f"
	depends on OEM_QC_LOGIC
	default n
	help
	  support oem_qc_logic_wt6670f

config OEM_FUEL_GAUGE_SM5602
	tristate "oem fuel gauge sm5602"
	depends on OEM_FUEL_GAUGE
	default n
	help
	  support oem_fuel_gauge_sm5602

config OEM_BATTERY_SWITCH_UPM2388
	tristate "oem battery switch upm2388"
	depends on OEM_BATTERY_SWITCH
	default n
	help
	  support oem_battery_switch_upm2388

config OEM_HVDCP_ALGO
	tristate "oem hvdcp algo"
	depends on OEM_TINNO_CHARGER
	default n
	help
	  support oem_hvdcp_algo

config OEM_PDC_ALGO
	tristate "oem pdc algo"
	depends on OEM_TINNO_CHARGER
	default n
	help
	  support oem_pdc_algo

config OEM_TINNO_CHARGE_MISC
	tristate "oem tinno charge misc"
	default n
	help
	  support oem_tinno_charge_misc
```
