/*
 * this is the dtsi sample for SC89890H.
 * update date:2024.04.15
 */

sc8989x_chg: chg@6A {
	compatible = "southchip,sc89890h";
	reg = <0x6A>;
	status = "okay";
	eint_name = "chr_stat";
	sc,intr-gpio = <&pio 3 IRQ_TYPE_EDGE_FALLING>;
	charger_name = "primary_chg";
	io-channels = <&pmic_auxadc AUXADC_VCDT>;
	io-channel-names = "pmic_vbus";
	sc,sc8989x,ico-en = <0>;
	sc,sc8989x,hvdcp-en = <0>;
	sc,sc8989x,auto-dpdm-en = <0>;
	sc,sc8989x,vsys-min = <5>; /*3500mV*/
	sc,sc8989x,vbatmin-sel = <0>; /*0:2.9V 1:2.5V*/
	sc,sc8989x,itrick = <3>; /*60 + val *60*/
	sc,sc8989x,iterm = <3>; /*30 + val * 60*/
	sc,sc8989x,vbat-cv = <38>; /*3840 + val * 16*/
	sc,sc8989x,vbat-low = <1>; /*0:2.8V 1:3V*/
	sc,sc8989x,vrechg = <0>; /*0:100mV 1:200mV*/
	sc,sc8989x,en-term = <1>;
	sc,sc8989x,stat-dis = <0>;
	sc,sc8989x,wd-time = <0>; /*0:Dis 1:40s 2:80s 3:160s*/
	sc,sc8989x,en-timer = <1>;
	sc,sc8989x,charge-timer = <2>; /*0:5h 1:8h 2:12h 3:20h*/
	sc,sc8989x,bat-comp = <0>; /*val * 20*/
	sc,sc8989x,vclamp = <0>; /*val *32*/
	sc,sc8989x,votg = <12>; /*3900 + val * 100*/
	sc,sc8989x,iboost = <7>; /*0:0.5A 3:1.4A 5:1.875A 7:2.45A*/
	sc,sc8989x,force_vindpm = <0>;
	sc,sc8989x,vindpm = <18>; /*2600 + val * 100*/
};
