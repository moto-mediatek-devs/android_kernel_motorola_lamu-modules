/*
 * this is the dtsi sample for AW35616.
 * update date:2024.04.15
 */

usb_type_c_aw35616@60 {
	status = "okay";
	compatible = "awinic,usb_type_c_aw35616";
	reg = <0x60>;
	aw35616,irq-gpio = <&pio 4 0x0>;
	aw35616-tcpc,name = "type_c_port0";
	aw35616-tcpc,role_def = <5>; /* 1: SNK Only, 2: SRC Only, 3: DRP, 4: Try.SRC, 5: Try.SNK */
	aw35616,rp_level = <0>; /* 0: Default, 1: 1.5, 2: 3.0 */
	aw35616-tcpc,notifier_supply_num = <3>; /* the number of notifier supply */
	aw35616_acc_support = <0>; /* 0:support, 1:No support */
	aw35616_toggle_cycle = <0>; /* 0:Disable, 1:40ms, 2:80ms, 3:160ms */
};
