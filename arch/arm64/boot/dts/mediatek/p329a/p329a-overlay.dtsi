/*[TN.NJDC] all modules overlay files.start*/

#include "p329a-overlay-charger.dtsi"
#include "p329a-overlay-display.dtsi"
#include "p329a-overlay-fingerprint.dtsi"
#include "p329a-overlay-led.dtsi"
#include "p329a-overlay-nfc.dtsi"
#include "p329a-overlay-sensor.dtsi"
#include "p329a-overlay-touch.dtsi"
#include "p329a-overlay-vibrator.dtsi"
#include "p329a-overlay-key.dtsi"
#include "p329a-overlay-card.dtsi"
#include "p329a-overlay-audio.dtsi"
#include "p329a-overlay-ntc.dtsi"

/*[TN.NJDC] all modules overlay files.end*/
